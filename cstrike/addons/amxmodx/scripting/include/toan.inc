
#include <zombieplague>
#include <zp50_gamemodes>

native sfpistol(id)
native janus1(id)
native janus9(id)
native jaydagger(id)
native dinfinity(id)
native summonknife(id)
native makefs()
native Snark(id)
native at15hw(id)
native hk416(id)
native crow3(id)
native crow5(id)
native crow7(id)
native crow11(id)
native nav_set_portrait(id)
native nav_set_special_ammo(id, val)
native skull3(id)
native skull4(id)
native skull5(id)
native skull6(id)
native skull7(id)
native skull8(id)
native skullaxe(id)
native skull11(id)
native katana(id)
native sfmg(id)
native chaingrenade(id)
native KnockbackNade(id)
native gunkata(id)
native m82a1(id)

native md_zb_skill(id, type)
native is_deadlyshot(id)